/ {
	chosen {
		zephyr,display = &esp32_wroom_ssd1306_128x64;
	};
};

&i2c0 {
	status = "okay";
	// sda-pin = <5>;
	// scl-pin = <4>;
	// sda-gpios = <&gpio0 5 GPIO_OUTPUT>;
	// scl-gpios = <&gpio0 4 GPIO_OUTPUT>;
	sda-gpios = <&gpio0 21 GPIO_OPEN_DRAIN>;
	scl-gpios = <&gpio0 22 GPIO_OPEN_DRAIN>;

	// clock-frequency = <I2C_BITRATE_FAST>;
	// clock-frequency = <I2C_BITRATE_STANDARD>;
	clock-frequency = <I2C_BITRATE_STANDARD>;

	esp32_wroom_ssd1306_128x64: ssd1306@3c {
		compatible = "solomon,ssd1306fb";
		reg = <0x3c>;
		// label = "SSD1306";
		width = <128>;
		height = <64>;
		segment-offset = <0>;
		page-offset = <0>;
		display-offset = <0>;
		multiplex-ratio = <63>;
		segment-remap;
		com-invdir;
		prechargep = <0x22>;
		ready-time-ms = <500>;
	};
};

